/*
 * Copyright (c) 2022 Lau Kar Rui
 *
 * SPDX-License-Identifier: MIT
 */

#include "cnano.dtsi"

&default_transform {
    col-offset = <6>;
};

&kscan0 {
    col-gpios
        = <&gpio1 4 GPIO_ACTIVE_HIGH> // col6 in the schematic
        , <&gpio0 11 GPIO_ACTIVE_HIGH> // col5 in the schematic
        , <&gpio1 0 GPIO_ACTIVE_HIGH> // col4 in the schematic
        , <&gpio0 9 GPIO_ACTIVE_HIGH> // col3 in the schematic
        , <&gpio0 29 GPIO_ACTIVE_HIGH> // col2 in the schematic
        , <&gpio0 2 GPIO_ACTIVE_HIGH> // col1 in the schematic
        ;
};

// trackball bus
&spi0 {
    status = "okay"; //okay
    sck-pin = <&gpio0 8>;
    mosi-pin = <&gpio0 17>;
    miso-pin = <&gpio0 6>; // same as mosi (3-wire spi)
    cs-gpios = <&gpio0 20 GPIO_ACTIVE_LOW>;
};

&trackball {
    status = "okay"; //okay
    irq-gpios = <&gpio0 6 (GPIO_ACTIVE_LOW | GPIO_PULL_UP)>;
};